## main/Kconfig.projbuild
```kconfig
menu "Occupancy Meter Configuratie"

    config OCC_WIFI_SSID
        string "Wifi SSID"
        default "raim"
        help
            Wifi SSID

    config OCC_WIFI_PASSWORD
        string "Wifi Wachtwoord"
        default "4dongelek"
        help
            Wifi wachtwoord

    config OCC_MAXIMUM_RETRY
        int "Maximum aantal retries"
        default 5
        help
            Hoeveel keer de ESP zal proberen te verbinden met het wifi netwerk.

endmenu
```
